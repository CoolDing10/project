## Yocto_project/yocto/meta-adaptive-video/conf/layer.conf
```bitbake
BBPATH .= ":${LAYERDIR}"
BBFILES += "${LAYERDIR}/recipes-*/*/*.bb ${LAYERDIR}/recipes-*/*/*.bbappend"

BBFILE_COLLECTIONS += "adaptive-video"
BBFILE_PATTERN_adaptive-video = "^${LAYERDIR}/"
BBFILE_PRIORITY_adaptive-video = "8"
LAYERDEPENDS_adaptive-video = "core"

LAYERSERIES_COMPAT_adaptive-video = "kirkstone langdale mickledore nanbield scarthgap styhead walnascar whinlatter wrynose"
```
